## config/west.yml
```yaml
manifest:
  remotes:
    - name: zmkfirmware
      url-base: https://github.com/zmkfirmware
    - name: urob
      url-base: https://github.com/urob
  projects:
    - name: eyelash_corne
      url: https://github.com/a741725193/zmk-new_corne
      revision: main
    - name: zmk
      remote: zmkfirmware
      revision: main
      import: app/west.yml
    - name: zmk-helpers
      remote: urob
      revision: main
    
    # ZMK modules
    - name: zmk-adaptive-key
      path: modules/zmk/adaptive-key
    - name: zmk-auto-layer
      path: modules/zmk/auto-layer
    - name: zmk-leader-key
      path: modules/zmk/leader-key
    - name: zmk-tri-state
      path: modules/zmk/tri-state
    - name: zmk-unicode
      path: modules/zmk/unicode
      
  self:
    path: config
```
