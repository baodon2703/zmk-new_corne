#include <input/processors.dtsi>
#include <zephyr/dt-bindings/input/input-event-codes.h>
#include <behaviors.dtsi>

#include <dt-bindings/zmk/bt.h>
#include <dt-bindings/zmk/keys.h>
#include <dt-bindings/zmk/outputs.h>
#include <dt-bindings/zmk/pointing.h>
#include <dt-bindings/zmk/rgb.h>
#include <dt-bindings/zmk/behaviors.h>

#include <zmk-helpers/helper.h>

#include "eyelash_corne_keylabels.h"


#define XXX &none
#define ___ &trans

#define DEFAULT 0
#define NAV     1
#define NUM     2
#define SYM     3
#define MOUSE   4
#define FUNC    5
#define WINDOW  6
#define QWERTY  7

// Meh key (GUI+Shift+Alt)
#define MEH LS(LA(LGUI))

/*  --------------   */
/*  Global defaults  */
/*  --------------   */

#define QUICK_TAP_MS 175

&sk { // Sticky Key
  release-after-ms = <900>;
  quick-release;
};

&sl { // Sticky Layer - Allow sticky mods to chord across sticky layers.
  ignore-modifiers;
};

&lt { // Layer Tap
  flavor = "balanced";
  tapping-term-ms = <200>;
  quick-tap-ms = <QUICK_TAP_MS>;
};

/*  ---------------  */
/*  Custom Behaviors */
/*  ---------------  */

#include "behaviors/mouse.dtsi"

// Smart-mouse, requires tri-state module.
ZMK_TRI_STATE(
    smart_mouse, bindings = <&tog MOUSE>, <&none>, <&tog MOUSE>;
    ignored-key-positions =
        <RT1 RT2 RT3 RM1 RM2 RM3>;
    ignored-layers = <MOUSE NAV>;)

#include "behaviors/macros.dtsi"
#include "behaviors/combos.dtsi"

#include "behaviors/num_word.dtsi" 
#include "behaviors/nav_word.dtsi" 

#include "behaviors/home_row_mods.dtsi" 

#include "behaviors/magic_shift.dtsi"
#include "behaviors/super_copy.dtsi"




/*  --------------  */
/*    Custom Keys   */
/*  --------------  */ 

#define SIMPLE_MORPH(NAME, MOD, BINDING1, BINDING2)           \
  ZMK_MOD_MORPH(NAME, mods = <(MOD_L##MOD | MOD_R##MOD)>;     \
                bindings = <BINDING1>, <BINDING2>;)

SIMPLE_MORPH(cma_smcln,  SFT,   &kp COMMA,   &kp SEMICOLON)
SIMPLE_MORPH(at_hash,    SFT,   &kp AT,      &kp HASH)

// Tap: backspace | Lshft + tap: delete | Rshft + tap: shift-delete.
ZMK_MOD_MORPH(bs_del, bindings = <&kp BSPC>, <&kp DEL>;
              mods = <(MOD_LSFT|MOD_RSFT)>; keep-mods = <MOD_RSFT>;)

// Alt+Tab swapper, requires tri-state module.
ZMK_TRI_STATE(swapper, bindings = <&kt LCTRL>, <&kp TAB>, <&kt LCTRL>;
              ignored-key-positions = <RM1 RM2 RM3 RT2>;)


// Tap: sticky SYM  | Hold: SYM-layer.
#define SMART_SYM &smart_sym SYM SYM
ZMK_HOLD_TAP(smart_sym, bindings = <&mo>, <&sl>; flavor = "balanced";
             tapping-term-ms = <200>; quick-tap-ms = <QUICK_TAP_MS>;)

// Tap: sticky WINDOW  | Hold: WINDOW-layer.
#define SMART_WINDOW &smart_window WINDOW WINDOW
ZMK_HOLD_TAP(smart_window, bindings = <&mo>, <&sl>; flavor = "balanced";
             tapping-term-ms = <200>; quick-tap-ms = <QUICK_TAP_MS>;)

/*  --------------  */
/*  Custom Actions  */
/*  --------------  */

// Tap: Undo | Double-tap: Redo
ZMK_TAP_DANCE(undo_redo, bindings = <&undo>, <&redo>;
              tapping-term-ms = <200>;)


#define ZMK_BASE_LAYER(name, LT, JT, RT, LM, JM, RM, LB, JB, RB, LH, RH)      \
  ZMK_LAYER(                                                                  \
      name,                                                                   \
      LT JT RT                                                                \
      LM JM RM                                                                \
      LB JB RB                                                                \
      LH    RH                                                                \
  )

ZMK_BASE_LAYER(ColemakDH,
//╭─────────────┬───────────────┬───────────────┬──────────────┬─────────────┬──────────────╮ ╭─────────────┬─────────────┬─────────────╮ ╭─────────────┬─────────────┬─────────────┬─────────────┬─────────────┬─────────────╮
      &kp ESC         &kp Q           &kp W        &hml MEH F         &kp P         &kp B      ,                &kp C_VOL_UP              ,     &kp J        &kp L     &hmr MEH U        &kp Y       &kp BSPC      &undo_redo  ,
//├─────────────┼───────────────┼───────────────┼──────────────┼─────────────┼──────────────┤ ├─────────────┼─────────────┼─────────────┤ ├─────────────┼─────────────┼─────────────┼─────────────┼─────────────┼─────────────┤
      &kp TAB      &hml LSHFT A    &hml LALT R     &hml LGUI S   &hml LCTL T      &kp G    ,   &kp C_PREV     &kp C_PP     &kp C_NEXT  ,     &kp M      &hmr RCTRL N   &hmr RGUI E   &hmr RALT I   &hmr RSHFT O    &kp ENTER   ,
//├─────────────┼───────────────┼───────────────┼──────────────┼─────────────┼──────────────┤ ├─────────────┼─────────────┼─────────────┤ ├─────────────┼─────────────┼─────────────┼─────────────┼─────────────┼─────────────┤
      &kp LALT         &kp Z           &kp X           &kp C         &kp D         &kp V    ,      XXX      &kp C_VOL_DN                ,     &kp K         &kp H       &kp COMMA      &kp DOT       &kp SLASH     &kp LALT    ,
//╰─────────────┴───────────────┴───────────────┼──────────────┼─────────────┼──────────────┤ ╰─────────────┴─────────────┴─────────────╯ ├─────────────┼─────────────┼─────────────┼─────────────┴─────────────┴─────────────╯
                                                   SMART_NUM     SMART_NAV     SMART_SPACE   ,                                              MAGIC_SHIFT     SMART_SYM   SMART_WINDOW
//                                              ╰──────────────┴─────────────┴──────────────╯                                             ╰─────────────┴─────────────┴─────────────╯
)

ZMK_BASE_LAYER(Nav,
//╭─────────────┬───────────────┬───────────────┬──────────────┬─────────────┬─────────────╮ ╭─────────────┬─────────────┬─────────────╮ ╭─────────────┬─────────────┬─────────────┬─────────────┬─────────────┬─────────────╮
        XXX            &kp Q           &kp W           &kp F           &kp P         &kp B    ,                     XXX                   ,  &kp HOME      &kp END      &kp PG_UP     &kp PG_DN   &kp BSPC           XXX     ,
//├─────────────┼───────────────┼───────────────┼──────────────┼─────────────┼─────────────┤ ├─────────────┼─────────────┼─────────────┤ ├─────────────┼─────────────┼─────────────┼─────────────┼─────────────┼─────────────┤
        XXX            &kp A           &kp R           &kp S           &kp T         &kp G    ,       XXX           XXX           XXX     ,   &kp LEFT    &kp DOWN      &kp UP       &kp RIGHT       XXX         &swapper  ,
//├─────────────┼───────────────┼───────────────┼──────────────┼─────────────┼─────────────┤ ├─────────────┼─────────────┼─────────────┤ ├─────────────┼─────────────┼─────────────┼─────────────┼─────────────┼─────────────┤
        XXX            &kp Z           &kp X           &kp C           &kp D         &kp V    ,       XXX           XXX                   ,   &zoom_in      &zoom_out     &zoom_reset    XXX            XXX           ___     ,
//╰─────────────┴───────────────┴───────────────┼──────────────┼─────────────┼─────────────┤ ╰─────────────┴─────────────┴─────────────╯ ├─────────────┼─────────────┼─────────────┼─────────────┴─────────────┴─────────────╯
                                                     XXX           XXX          XXX      ,                                                 &kp ENTER        ___           ___
//                                              ╰──────────────┴─────────────┴─────────────╯                                             ╰─────────────┴─────────────┴─────────────╯
)

ZMK_BASE_LAYER(Num,
//╭─────────────┬───────────────┬───────────────┬──────────────┬─────────────┬─────────────╮ ╭─────────────┬─────────────┬─────────────╮ ╭─────────────┬─────────────┬─────────────┬─────────────┬─────────────┬─────────────╮
        ___            ___            ___              ___          ___          ___        ,                     XXX                   , &kp KP_MULTIPLY  &kp KP_N7     &kp KP_N8     &kp KP_N9     &kp BSPC         XXX     ,
//├─────────────┼───────────────┼───────────────┼──────────────┼─────────────┼─────────────┤ ├─────────────┼─────────────┼─────────────┤ ├─────────────┼─────────────┼─────────────┼─────────────┼─────────────┼─────────────┤
        ___            ___            ___          &swapper      &kp ENTER         ___   ,       XXX           XXX           XXX     ,   &kp KP_PLUS    &kp KP_N4     &kp KP_N5     &kp KP_N6   &kp KP_MINUS   &kp KP_EQUAL,
//├─────────────┼───────────────┼───────────────┼──────────────┼─────────────┼─────────────┤ ├─────────────┼─────────────┼─────────────┤ ├─────────────┼─────────────┼─────────────┼─────────────┼─────────────┼─────────────┤
        ___            ___            ___              ___       &quick_cmd_tab   ___  ,           XXX           XXX                   ,  &kp KP_DIVIDE   &kp KP_N1     &kp KP_N2     &kp KP_N3     &kp COLON        ___     ,
//╰─────────────┴───────────────┴───────────────┼──────────────┼─────────────┼─────────────┤ ╰─────────────┴─────────────┴─────────────╯ ├─────────────┼─────────────┼─────────────┼─────────────┴─────────────┴─────────────╯
                                                       ___         &mo NAV           ___     ,                                                &kp KP_N0    &kp KP_N0     &kp COMMA
//                                              ╰──────────────┴─────────────┴─────────────╯                                             ╰─────────────┴─────────────┴─────────────╯
)

ZMK_BASE_LAYER(Symbols,
//╭─────────────┬───────────────┬───────────────┬──────────────┬─────────────┬─────────────╮ ╭─────────────┬─────────────┬─────────────╮ ╭─────────────┬─────────────┬─────────────┬─────────────┬─────────────┬─────────────╮
        ___         &kp EXCL         &kp AT         &kp HASH      &kp DLLR      &kp PRCNT  ,                     XXX                   ,     &kp CARET     &kp AMPS      &kp ASTRK     &kp DEL       &kp BSPC         ___     ,
//├─────────────┼───────────────┼───────────────┼──────────────┼─────────────┼─────────────┤ ├─────────────┼─────────────┼─────────────┤ ├─────────────┼─────────────┼─────────────┼─────────────┼─────────────┼─────────────┤
        XXX         &kp PLUS        &kp MINUS       &kp EQUAL     &kp UNDER      &kp SQT   ,       XXX           XXX           XXX     ,     &kp LPAR      &kp LBRC      &kp LBKT       &kp LT       &kp SEMI         XXX     ,
//├─────────────┼───────────────┼───────────────┼──────────────┼─────────────┼─────────────┤ ├─────────────┼─────────────┼─────────────┤ ├─────────────┼─────────────┼─────────────┼─────────────┼─────────────┼─────────────┤
        ___         &kp TILDE        &kp GRAVE       &kp BSLH      &kp PIPE       &kp DQT  ,       XXX           XXX                   ,     &kp RPAR      &kp RBRC      &kp RBKT       &kp GT       &kp COLON        ___     ,
//╰─────────────┴───────────────┴───────────────┼──────────────┼─────────────┼─────────────┤ ╰─────────────┴─────────────┴─────────────╯ ├─────────────┼─────────────┼─────────────┼─────────────┴─────────────┴─────────────╯
                                                    &to QWERTY    &mo FUNC    &to MOUSE     ,                                                   ___           ___           ___
//                                              ╰──────────────┴─────────────┴─────────────╯                                             ╰─────────────┴─────────────┴─────────────╯
)

ZMK_BASE_LAYER(Mouse,
//╭─────────────┬───────────────┬───────────────┬──────────────┬─────────────┬─────────────╮ ╭─────────────┬─────────────┬─────────────╮ ╭─────────────┬─────────────┬─────────────┬─────────────┬─────────────┬─────────────╮
        ___           &kp F12          &kp F7         &kp F8         &kp F9       XXX     ,                     XXX                   ,       XXX         &mkp LCLK     U_MS_U         &mkp RCLK           XXX   &to DEFAULT      ,
//├─────────────┼───────────────┼───────────────┼──────────────┼─────────────┼─────────────┤ ├─────────────┼─────────────┼─────────────┤ ├─────────────┼─────────────┼─────────────┼─────────────┼─────────────┼─────────────┤
        XXX           &kp F11          &kp F4         &kp F5        &kp F6         XXX    ,       XXX           XXX           XXX     ,       XXX          U_MS_L        U_MS_D       U_MS_R          XXX           XXX     ,
//├─────────────┼───────────────┼───────────────┼──────────────┼─────────────┼─────────────┤ ├─────────────┼─────────────┼─────────────┤ ├─────────────┼─────────────┼─────────────┼─────────────┼─────────────┼─────────────┤
        ___           &kp F10          &kp F1         &kp F2         &kp F3       XXX     ,       XXX           XXX                   ,       XXX         &kp LCTRL      &kp LGUI      &kp LALT      &kp LSHFT           ___     ,
//╰─────────────┴───────────────┴───────────────┼──────────────┼─────────────┼─────────────┤ ╰─────────────┴─────────────┴─────────────╯ ├─────────────┼─────────────┼─────────────┼─────────────┴─────────────┴─────────────╯
                                                    XXX           XXX           XXX     ,                                                      XXX           XXX           XXX
//                                              ╰──────────────┴─────────────┴─────────────╯                                             ╰─────────────┴─────────────┴─────────────╯
)


ZMK_BASE_LAYER(Functions,
//╭─────────────┬───────────────┬───────────────┬──────────────┬─────────────┬─────────────╮ ╭───────────────┬───────────────┬───────────────╮ ╭─────────────┬─────────────┬───────────────┬───────────────┬───────────────┬───────────────╮
        XXX        &kp C_VOL_DN    &kp C_VOL_UP   &kp C_PREV       &kp C_NEXT     &kp C_PP ,                        XXX                        , &rgb_ug RGB_SPI &rgb_ug RGB_EFF &rgb_ug RGB_BRI     XXX             XXX      &to DEFAULT       ,
//├─────────────┼───────────────┼───────────────┼──────────────┼─────────────┼─────────────┤ ├───────────────┼───────────────┼───────────────┤ ├─────────────┼─────────────┼───────────────┼───────────────┼───────────────┼───────────────┤
    &bt BT_CLR     &bt BT_SEL 0    &bt BT_SEL 1   &bt BT_SEL 2   &bt BT_SEL 3      XXX     ,        XXX             XXX             XXX        , &rgb_ug RGB_SPD &rgb_ug RGB_EFR &rgb_ug RGB_BRD     XXX             XXX             XXX      ,  
//├─────────────┼───────────────┼───────────────┼──────────────┼─────────────┼─────────────┤ ├───────────────┼───────────────┼───────────────┤ ├─────────────┼─────────────┼───────────────┼───────────────┼───────────────┼───────────────┤
    &bootloader        XXX             XXX             XXX           XXX           XXX     ,        XXX             XXX                        , &rgb_ug RGB_TOG     XXX             XXX             XXX             XXX             XXX      ,
//╰─────────────┴───────────────┴───────────────┼──────────────┼─────────────┼─────────────┤ ╰───────────────┴───────────────┴───────────────╯ ├─────────────┼─────────────┼───────────────┼───────────────┴───────────────┴───────────────╯
                                                     XXX           XXX           XXX     ,                                                         XXX           XXX           XXX
//                                              ╰──────────────┴─────────────┴─────────────╯                                                   ╰─────────────┴─────────────┴───────────────╯
)

ZMK_BASE_LAYER(Window,
//╭─────────────┬───────────────┬───────────────┬──────────────┬─────────────┬─────────────╮ ╭─────────────┬─────────────┬─────────────╮ ╭─────────────┬─────────────┬─────────────┬─────────────┬─────────────┬─────────────╮
      &kp ESC         &kp Q           &kp W           &kp F           &kp P         &kp B    ,                &kp C_VOL_UP              ,     &kp J         &kp L         &kp U         &kp Y         &kp BSPC    &to DEFAULT  ,
//├─────────────┼───────────────┼───────────────┼──────────────┼─────────────┼─────────────┤ ├─────────────┼─────────────┼─────────────┤ ├─────────────┼─────────────┼─────────────┼─────────────┼─────────────┼─────────────┤
      &kp TAB         &kp A           &kp R           &kp S           &kp T         &kp G    ,   &kp C_PREV     &kp C_PP     &kp C_NEXT  ,     &kp M         &kp N         &kp E         &kp I         &kp O     &kp ENTER   ,
//├─────────────┼───────────────┼───────────────┼──────────────┼─────────────┼─────────────┤ ├─────────────┼─────────────┼─────────────┤ ├─────────────┼─────────────┼─────────────┼─────────────┼─────────────┼─────────────┤
      &kp LALT        &kp Z           &kp X           &kp C           &kp D         &kp V    ,      XXX      &kp C_VOL_DN                ,     &kp K         &kp H       &kp COMMA      &kp DOT       &kp SLASH   &kp LALT    ,
//╰─────────────┴───────────────┴───────────────┼──────────────┼─────────────┼─────────────┤ ╰─────────────┴─────────────┴─────────────╯ ├─────────────┼─────────────┼─────────────┼─────────────┴─────────────┴─────────────╯
                                                     XXX           XXX           XXX     ,                                                         XXX           XXX        XXX
//                                              ╰──────────────┴─────────────┴─────────────╯                                             ╰─────────────┴─────────────┴─────────────╯
)

ZMK_BASE_LAYER(Qwerty,
//╭─────────────┬───────────────┬───────────────┬──────────────┬─────────────┬──────────────╮ ╭─────────────┬─────────────┬─────────────╮ ╭─────────────┬─────────────┬─────────────┬─────────────┬─────────────┬─────────────╮
      &kp ESC         &kp Q           &kp W           &kp E           &kp R         &kp T      ,                &kp C_VOL_UP              ,     &kp Y        &kp U         &kp I         &kp O         &kp P       &to DEFAULT    ,
//├─────────────┼───────────────┼───────────────┼──────────────┼─────────────┼──────────────┤ ├─────────────┼─────────────┼─────────────┤ ├─────────────┼─────────────┼─────────────┼─────────────┼─────────────┼─────────────┤
      &kp TAB         &kp A           &kp S           &kp D           &kp F         &kp G    ,   &kp C_PREV     &kp C_PP     &kp C_NEXT  ,     &kp H        &kp J         &kp K         &kp L       &kp SEMI      &kp SQT     ,
//├─────────────┼───────────────┼───────────────┼──────────────┼─────────────┼──────────────┤ ├─────────────┼─────────────┼─────────────┤ ├─────────────┼─────────────┼─────────────┼─────────────┼─────────────┼─────────────┤
      &kp LSHFT        &kp Z           &kp X           &kp C           &kp V         &kp B    ,      XXX      &kp C_VOL_DN                ,     &kp N         &kp M       &kp COMMA      &kp DOT       &kp SLASH   &kp RSHFT   ,
//╰─────────────┴───────────────┴───────────────┼──────────────┼─────────────┼──────────────┤ ╰─────────────┴─────────────┴─────────────╯ ├─────────────┼─────────────┼─────────────┼─────────────┴─────────────┴─────────────╯
                                                    &kp LGUI      &kp LALT      &kp SPACE    ,                                               &kp ENTER     &kp RALT     &kp RCTRL
//                                              ╰──────────────┴─────────────┴──────────────╯                                             ╰─────────────┴─────────────┴─────────────╯
)
