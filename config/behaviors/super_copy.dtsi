#include <dt-bindings/zmk/behaviors.h>
#include <dt-bindings/zmk/keys.h>
#include <zmk-helpers/helper.h>

// Tap: Copy | Double Tab: Paste | Ctrl: Cut | Alt: Mac Paste Cut file
ZMK_TAP_DANCE(cp_pst_cut, bindings = <&mt LG(X) LG(C)>, <&kp LG(V)>; 
              tapping-term-ms = <200>;)
ZMK_MOD_MORPH(cp_pst_cut_mv,
    bindings = <&cp_pst_cut>, <&kp LG(LA(V))>;
    mods = <(MOD_LCTL|MOD_RCTL)>;
)