/*                                      
                  42 KEY MATRIX / LAYOUT MAPPING
  ╭─────────────────────────╮ ╭──────────╮ ╭────────────────────────╮ 
  │  0   1   2   3   4   5  │ │     6    │ │ 7   8   9   10  11  12 │ 
  │ 13  14  15  16  17  18  │ │ 19 20 21 │ │ 22  23  24  25  26  27 │ 
  │ 28  29  30  31  32  33  │ │ 34 35    │ │ 36  37  38  39  40  41 │ 
  ╰───────────╮ 42  43  44  │ │          │ │ 45  46  47 ╭───────────╯ 
              ╰─────────────╯ ╰──────────╯ ╰────────────╯             
  ╭─────────────────────────╮ ╭──────────╮ ╭─────────────────────────╮
  │ LT5 LT4 LT3 LT2 LT1 LT0 │ │    DU    │ │ RT0 RT1 RT2 RT3 RT4 RT5 │
  │ LM5 LM4 LM3 LM2 LM1 LM0 │ │ DF DC DR │ │ RM0 RM1 RM2 RM3 RM4 RM5 │
  │ LB5 LB4 LB3 LB2 LB1 LB0 │ │ XX DD    │ │ RB0 RB1 RB2 RB3 RB4 RB5 │
  ╰───────────╮ LH2 LH1 LH0 │ │          │ │ RH0 RH1 RH2 ╭───────────╯
              ╰─────────────╯ ╰──────────╯ ╰─────────────╯             */

#include "../eyelash_corne_keylabels.h"

#define COMBO_TERM_FAST 18
#define COMBO_TERM_SLOW 30

#define COMBO_IDLE_FAST 150
#define COMBO_IDLE_SLOW 50


/*  --------------  */
/*        Misc      */
/*  --------------  */

// Turn off the device
&soft_off { hold-time-ms = <2000>; };
ZMK_COMBO(cb_soft_off,   &soft_off,    LH0 RH0,      DEFAULT) 

// Activate FUNC layer
ZMK_COMBO(cb_to_func,    &to FUNC,     RT5 RM5 RB5,   DEFAULT) 

// Screenshots
ZMK_COMBO(cb_ss,         &ss_zone,     LM4 LB4,      DEFAULT) 
ZMK_COMBO(cb_ss_mac,     &ss_mc_zone,  LM5 LB5,      DEFAULT) 


/*  --------------  */
/*     Left Hand    */
/*  --------------  */
// Tab 
ZMK_COMBO(cb_tab,        &kp TAB,      LM3 LM2,      DEFAULT,       COMBO_TERM_FAST, COMBO_IDLE_FAST) 
// Escape
ZMK_COMBO(cb_esc,        &kp ESC,      LM2 LM1,      DEFAULT,       COMBO_TERM_FAST, COMBO_IDLE_FAST)
// Enter
ZMK_COMBO(cb_enter,      &kp ENTER,    LM4 LM3,      DEFAULT,       COMBO_TERM_FAST, COMBO_IDLE_FAST)

/*  --------------  */
/*    Right Hand    */
/*  --------------  */

// Smart mouse
ZMK_COMBO(mouse,         &smart_mouse, RT0 RT1,      DEFAULT,       COMBO_TERM_FAST, COMBO_IDLE_FAST)

// Left Brace {
ZMK_COMBO(cb_lbrc,       &kp LBRC,     RT1 RT2,      DEFAULT,       COMBO_TERM_FAST, COMBO_IDLE_FAST) 
// Right Brace }
ZMK_COMBO(cb_rbrc,       &kp RBRC,     RT2 RT3,      DEFAULT,       COMBO_TERM_FAST, COMBO_IDLE_FAST) 

// Left Para (
ZMK_COMBO(cb_lpar,       &kp LPAR,     RM1 RM2,      DEFAULT,       COMBO_TERM_FAST, COMBO_IDLE_FAST) 
// Right Para )
ZMK_COMBO(cb_rpar,       &kp RPAR,     RM2 RM3,      DEFAULT,       COMBO_TERM_FAST, COMBO_IDLE_FAST) 

// Left Bracket [
ZMK_COMBO(cb_lbkt,       &kp LBKT,     RM0 RM1,      DEFAULT,       COMBO_TERM_FAST, COMBO_IDLE_FAST) 
// Right Bracket ]
ZMK_COMBO(cb_rbkt,       &kp RBKT,     RB0 RB1,      DEFAULT,       COMBO_TERM_FAST, COMBO_IDLE_FAST) 

// Angle brackets < >
ZMK_COMBO(cb_lt,         &kp LT,       RB1 RB2,      DEFAULT,       COMBO_TERM_FAST, COMBO_IDLE_FAST)
ZMK_COMBO(cb_gt,         &kp GT,       RB2 RB3,      DEFAULT,       COMBO_TERM_FAST, COMBO_IDLE_FAST)
