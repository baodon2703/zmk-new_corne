
//╭─────┬─────┬─────┬─────┬─────┬─────╮ ╭─────┬─────┬─────╮ ╭─────┬─────┬─────┬─────┬─────┬─────╮
//   0     1     2     3     4     5            6              7     8     9     10   11    12
//├─────┼─────┼─────┼─────┼─────┼─────┤ ├─────┼─────┼─────┤ ├─────┼─────┼─────┼─────┼─────┼─────┤
//   13    14    15    16    17    18     19    20    21       22    23    24    25   26    27
//├─────┼─────┼─────┼─────┼─────┼─────┤ ├─────┼─────┼─────┤ ├─────┼─────┼─────┼─────┼─────┼─────┤
//   28    29    30    31    32    33     34    35             36    37    38    39   40    41
//╰─────┴─────┴─────┼─────┼─────┼─────┤ ╰─────┴─────┴─────╯ ├─────┼─────┼─────┼─────┴─────┴─────╯
//                     42    43   44                           45    46    47
//                  ╰─────┴─────┴─────╯                     ╰─────┴─────┴─────╯


#define COMBO_TERM_FAST 18
#define COMBO_TERM_SLOW 30

#define COMBO_IDLE_FAST 150
#define COMBO_IDLE_SLOW 50


/*  --------------  */
/*        Misc      */
/*  --------------  */

// Turn off the device
&soft_off { hold-time-ms = <2000>; };
ZMK_COMBO(cb_soft_off,   &soft_off,    44 45,      ALL) 

// Activate FUNC layer
ZMK_COMBO(cb_to_func,    &to FUNC,     12 27 41,   DEFAULT) 

// Screenshots
ZMK_COMBO(cb_ss,         &ss_zone,     14 29,      DEFAULT) 
ZMK_COMBO(cb_ss_mac,     &ss_mc_zone,  13 28,      DEFAULT) 


/*  --------------  */
/*     Left Hand    */
/*  --------------  */
// Tab 
ZMK_COMBO(cb_tab,        &kp TAB,      15 16,      DEFAULT) 



/*  --------------  */
/*    Right Hand    */
/*  --------------  */

// Left Para (
ZMK_COMBO(cb_lpar,       &kp LPAR,     23 24,      DEFAULT NUM) 
// Right Para )
ZMK_COMBO(cb_rpar,       &kp RPAR,     24 25,      DEFAULT NUM) 
// // Left Brace {
// ZMK_COMBO(cb_lbrc,       &kp LBRC,     8 9,        DEFAULT) 
// // Right Brace {
// ZMK_COMBO(cb_rbrc,       &kp RBRC,     9 10,       DEFAULT) 
// Left Bracket [
ZMK_COMBO(cb_lbkt,       &kp LBKT,     37 38,      DEFAULT) 
// Right Bracket ]
ZMK_COMBO(cb_rbkt,       &kp RBKT,     38 39,      DEFAULT) 

// Backspace
ZMK_COMBO(cb_bksp,       &kp BSPC,     8 9,        DEFAULT)
ZMK_COMBO(cb_del,        &kp DEL,      9 10,       DEFAULT)

// Enter
ZMK_COMBO(cb_enter,      &kp ENTER,    25 26,      DEFAULT)
